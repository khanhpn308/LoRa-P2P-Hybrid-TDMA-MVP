## firmware/gateway_master/main/Kconfig.projbuild
```kconfig
# Project-level configuration for Gateway Master

menu "Gateway Master Configuration"

    menu "Gateway Device Identity & Network"
        config GATEWAY_ID
            string "Gateway Identity"
            default "gw-a"
            help
                Canonical gateway identifier (e.g., gw-a, gw-b).
                Used for MQTT topics and client identity.

        config GATEWAY_TARGET_GW_ID
            int "Gateway Numeric Network ID (0..254)"
            default 1
            range 0 254
            help
                Numeric gateway network ID matching DOWN_SYNC_BEACON origin and unicast filtering.
    endmenu

    menu "WiFi Station Configuration"
        config GATEWAY_WIFI_SSID
            string "Gateway WiFi SSID"
            default "myssid"
            help
                SSID for the WiFi access point the Gateway connects to.

        config GATEWAY_WIFI_PASSWORD
            string "Gateway WiFi Password"
            default "mypassword"
            help
                WPA2 pre-shared key for WiFi access.

        config GATEWAY_WIFI_MAX_RETRY
            int "WiFi Maximum Fast Retries"
            default 5
            range 1 50
            help
                Initial rapid reconnect attempts before exponential backoff.
    endmenu

    menu "MQTT 5.0 Broker Configuration"
        config GATEWAY_BROKER_HOST
            string "MQTT Broker Host"
            default "192.168.1.10"
            help
                Mosquitto MQTT broker hostname or IP address.

        config GATEWAY_BROKER_PORT
            int "MQTT Broker Port"
            default 8883
            range 1 65535
            help
                Mosquitto MQTT broker TLS port (8883 for TLS, 1883 for plain).

        config GATEWAY_BROKER_URI
            string "MQTT Broker URI override"
            default ""
            help
                Optional full URI override (e.g. mqtts://192.168.1.10:8883).
                If empty, constructed from host and port.

        config GATEWAY_TRANSPORT_QUEUE_SIZE
            int "Outbound MQTT Event Queue Capacity"
            default 16
            range 4 128
            help
                Bounded FreeRTOS queue depth for decoupling TDMA radio loop from network.

        config GATEWAY_TRANSPORT_TASK_STACK_SIZE
            int "Transport Task Stack Size (bytes)"
            default 8192
            range 4096 32768
            help
                Stack size in bytes for the dedicated gateway transport task.
    endmenu

endmenu
```

## firmware/quan/components/bench_console/Kconfig
```kconfig
menu "Event local bench (not an RF profile)"
config BENCH_CONSOLE_DEBOUNCE_MS
    int "Logical button debounce for UART bench, milliseconds"
    range 1 10000
    default 30
    help
        Bench example only, NOT_VERIFIED for a physical switch.
        No GPIO mapping or radio timing is configured by this setting.
endmenu
```

## firmware/quan/components/quan_console/Kconfig
```kconfig
menu "Quan local bench (not an RF profile)"
config QUAN_BENCH_DEBOUNCE_MS
    int "Logical button debounce for UART bench, milliseconds"
    range 1 10000
    default 30
    help
        Bench example only, NOT_VERIFIED for a physical switch.
        No GPIO mapping or radio timing is configured by this setting.
endmenu
```

## firmware/sensor_node/main/Kconfig.projbuild
```kconfig
# Project-level configuration for Sensor Node

menu "Sensor Node Configuration"

    menu "Node Identity & Target Gateway"
        config NODE_DEFAULT_NODE_ID
            int "Node Default Network ID (1..254)"
            default 1
            range 1 254
            help
                Default network ID before over-the-air assignment.

        config NODE_TARGET_GATEWAY_ID
            int "Target Gateway Network ID"
            default 1
            range 1 254
            help
                Network Gateway ID to target for uplinks and OTA Join.
    endmenu

    menu "Button Wakeup & Deep-Sleep Power"
        config NODE_BUTTON_GPIO
            int "Wakeup Button GPIO Pin"
            default 4
            range 0 39
            help
                Select the GPIO pin connected to your external push button.
                To wake up the ESP32 from Deep-Sleep via EXT0, the selected pin MUST be an RTC GPIO:
                - Safe general RTC pins: GPIO 4, 13, 14, 15, 25, 32, 33.
                - Input-only RTC pins (require external pull resistor): GPIO 34, 35, 36, 39.
                - On-board BOOT button: GPIO 0.
                CAUTION: Do NOT select pins reserved by SX1276 HW-001:
                - SCK = GPIO 5
                - MISO = GPIO 19
                - MOSI = GPIO 27
                - CS = GPIO 18
                - RST = GPIO 23
                - DIO0 = GPIO 26
                or UART console pins (TX=1, RX=3).

        config NODE_BUTTON_ACTIVE_LEVEL
            int "Button Active Trigger Level (0=Active Low / Pull-Up, 1=Active High / Pull-Down)"
            default 0
            range 0 1
            help
                0: Active Low (button connects to GND when pressed, ESP32 enables internal pull-up if supported).
                1: Active High (button connects to 3.3V when pressed, ESP32 enables internal pull-down if supported).

        config NODE_BUTTON_DEBOUNCE_MS
            int "Software Debounce Duration (ms)"
            default 50
            range 5 500
            help
                Stable level duration required to qualify a valid button press and filter switch bouncing noise.

        config NODE_BUTTON_HOLD_TIME_MS
            int "Minimum Press Hold Time (ms)"
            default 20
            range 5 200
            help
                Minimum duration the button must remain pressed to generate an event.

        config NODE_DEEP_SLEEP_TIMEOUT_SEC
            int "Periodic Deep-Sleep Fallback Wakeup Timer in seconds (0 = disabled, default 300 for 5-min liveness)"
            default 300
            range 0 86400
            help
                If greater than 0, sets an RTC timer wakeup fallback in addition to the button EXT0 wakeup.
                Default 300 (5 minutes) matches the node liveness heartbeat reporting cycle.
    endmenu

    menu "Periodic / Auto Event Transmission"
        config NODE_AUTO_EVENT_ENABLE
            bool "Enable Periodic Auto Event Transmission"
            default n
            help
                When enabled, the sensor node will automatically generate and transmit UP_EVENT packets
                periodically at a configured time interval, without requiring a physical button press.
                The physical button press (EXT0) remains concurrently active as an immediate manual trigger.

        config NODE_AUTO_EVENT_INTERVAL_SEC
            int "Auto Event Transmission Interval in seconds"
            default 30
            range 1 86400
            depends on NODE_AUTO_EVENT_ENABLE
            help
                Interval in seconds between periodic automatic event transmissions.
                The node wakes up from Deep-Sleep every interval seconds,
                generates an event, enqueues it to the persistent FIFO, and executes
                CAD + CSMA/CA transmission to the Gateway.
    endmenu

    menu "CAD / CSMA Timing & Airtime"
        config NODE_AIRTIME_PERMILLE
            int "Regulatory Duty Cycle Permille Limit (10 = 1.0%)"
            default 10
            range 1 100
            help
                Pre-transmit duty cycle enforcement limit (1.0% = 10 permille).

        config NODE_CAD_CW_MIN_MS
            int "CAD Minimum Contention Window in ms (CW_min)"
            default 16
            range 1 1000
            help
                Minimum contention window size for CAD exponential backoff in milliseconds (ADR-0004 default: 16).

        config NODE_CAD_CW_MAX_MS
            int "CAD Maximum Contention Window in ms (CW_max)"
            default 256
            range 1 5000
            help
                Maximum contention window size for CAD exponential backoff in milliseconds (ADR-0004 default: 256).

        config NODE_CAD_MAX_RETRIES
            int "CAD Maximum Retries (MAX_CAD_RETRIES)"
            default 5
            range 1 20
            help
                Maximum channel activity detection retries before backing off and deferring transmission (ADR-0004 default: 5).
    endmenu

    menu "Stop-and-Wait ARQ & Retransmission"
        config NODE_ARQ_MAX_RETRIES
            int "Stop-and-Wait ARQ Maximum Retries (tx_max)"
            default 3
            range 1 10
            help
                Maximum immediate retransmission attempts (tx_max) per event session
                when ACK is lost or invalid before sleeping (default: 3).

        config NODE_ARQ_BACKOFF_MIN_MS
            int "ARQ Minimum Random Backoff in ms"
            default 50
            range 10 1000
            help
                Minimum random backoff time in milliseconds before retransmission attempt.

        config NODE_ARQ_BACKOFF_MAX_MS
            int "ARQ Maximum Random Backoff in ms"
            default 200
            range 10 5000
            help
                Maximum random backoff time in milliseconds before retransmission attempt.
    endmenu

    menu "OTA V2 Join Configuration"
        config NODE_JOIN_GRANT_TIMEOUT_MS
            int "Join Grant Listen Timeout in ms"
            default 5000
            range 1000 15000
            help
                Listen timeout window for DOWN_JOIN_GRANT frame (default 5000 ms).
                Provides sufficient margin for MQTT relay to Backend and User Approval roundtrip.
    endmenu

    menu "Node Provisioning & Security Enforcement"
        config NODE_STRICT_PROVISIONING
            bool "Enforce Strict Provisioning (Fail-closed if K_JOIN missing)"
            default y
            help
                When enabled, node strictly requires a valid 32-byte K_JOIN provisioned in NVS
                namespace 'nvs_sec'. If missing or corrupted, RF transmission is immediately
                halted, SX1276 is forced into sleep, and the device halts/sleeps without
                emitting any radio packets (DEC-SEC-01, DEC-SEC-06).
                Disable only in lab testing environments where unprovisioned mock keys are explicitly permitted.
    endmenu

    menu "Local UI & Event Delivery Feedback"
        config NODE_ACK_LED_ENABLE
            bool "Enable Event Delivery Feedback LED (GPIO ACK blink)"
            default n
            help
                When enabled, pulses a local GPIO LED once upon verified receipt of DOWN_EVENT_ACK
                and successful FIFO ACK dequeue before entering Deep-Sleep.
                Opt-in by default until board revision and pin continuity are verified.

        config NODE_ACK_LED_GPIO
            int "Event ACK Feedback LED GPIO Pin"
            default 25
            range 0 33
            depends on NODE_ACK_LED_ENABLE
            help
                GPIO pin connected to the indicator LED anode (via 330 ohm - 1 k ohm resistor).
                Candidate: GPIO 25 (RTC GPIO).
                MUST NOT conflict with SX1276 (5, 18, 19, 23, 26, 27), UART console (1, 3),
                OLED I2C (21, 22), wakeup button, or input-only pins (34-39).

        config NODE_ACK_LED_PULSE_MS
            int "Event ACK Feedback LED Pulse Duration (ms)"
            default 200
            range 50 1000
            depends on NODE_ACK_LED_ENABLE
            help
                Duration in milliseconds to hold the LED pin HIGH on verified ACK.
                Default: 200 ms (recommended range: 50 - 1000 ms).
    endmenu

endmenu
```

## tests/hil/rf_timing/firmware/node_timing_app/sdkconfig.defaults
```kconfig
CONFIG_IDF_TARGET="esp32"
CONFIG_ESP_DEFAULT_CPU_FREQ_MHZ_240=y
CONFIG_ESP_TIMER_TASK_STACK_SIZE=4096
CONFIG_FREERTOS_HZ=1000
```
